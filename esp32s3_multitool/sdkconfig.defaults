## esp32s3_multitool/sdkconfig.defaults
```kconfig
CONFIG_ESP_DEFAULT_CPU_FREQ_240=y
CONFIG_ESP_CONSOLE_UART_DEFAULT=y
CONFIG_ESP_INT_WDT=y
CONFIG_ESP_TASK_WDT=y
CONFIG_ESP_SLEEP_POWER_DOWN_FLASH=y
CONFIG_PARTITION_TABLE_CUSTOM=y
CONFIG_PARTITION_TABLE_CUSTOM_FILENAME="partitions.csv"
CONFIG_PARTITION_TABLE_FILENAME="partitions.csv"
CONFIG_PARTITION_TABLE_OFFSET=0x8000
CONFIG_PARTITION_TABLE_CUSTOM_APP_BIN_OFFSET=0x10000
CONFIG_LV_MEM_SIZE_PERCENT=25
CONFIG_LV_USE_LOG=y
CONFIG_LV_COLOR_DEPTH_16=y
CONFIG_SPIRAM=y
CONFIG_ESPTOOLPY_FLASHFREQ_80M=y
```
